## ipc/Config.in
```kconfig
source "$BR2_EXTERNAL_IPC_PATH/main_app/Config.in"
source "$BR2_EXTERNAL_IPC_PATH/cpp-httplib/Config.in"
source "$BR2_EXTERNAL_IPC_PATH/simpleini/Config.in"
```

## ipc/cpp-httplib/Config.in
```kconfig
comment "cpp-httplib needs a toolchain w/ C++, wchar, threads"
	depends on !BR2_INSTALL_LIBSTDCPP || !BR2_USE_WCHAR || !BR2_TOOLCHAIN_HAS_THREADS

config BR2_PACKAGE_CPP_HTTPLIB
	bool "cpp-httplib"
	depends on BR2_INSTALL_LIBSTDCPP
	depends on BR2_TOOLCHAIN_HAS_THREADS
	depends on BR2_USE_WCHAR
	help
	  A C++ header-only HTTP/HTTPS server and client library.

	  https://github.com/yhirose/cpp-httplib
```

## ipc/main_app/Config.in
```kconfig
# ipc/main_app/Config.in

config BR2_PACKAGE_MAIN_APP
    bool "main_app"
    help
      Main application.
      
      This is Main program.
```

## ipc/mqtt_app/Config.in
```kconfig
# ipc/mqtt_app/Config.in

config BR2_PACKAGE_MQTT_APP
    bool "mqtt_app"
    help
      MQTT application.
      
      This is a simple MQTT client program.
```

## ipc/simpleini/Config.in
```kconfig
config BR2_PACKAGE_SIMPLEINI
	bool "simpleini"
	help
	  SimpleIni is a simple C++ library for reading and writing INI files.
```
